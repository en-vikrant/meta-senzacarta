## conf/machine/imx7dsenzacarta.conf
```bitbake
#@TYPE: Machine
#@NAME: i.MX7D SenzaCarta V3
#@SOC: i.MX7D
#@DESCRIPTION: Machine configuration for i.MX7D SenzaCarta
#@MAINTAINER: Vikrant A. P. <vikrant.ap@econote.in>

MACHINEOVERRIDES =. "mx7:mx7d:"

require conf/machine/include/imx-base.inc
require conf/machine/include/tune-cortexa7.inc

MACHINE_FEATURES += " epdc wifi bluetooth"

PREFERRED_PROVIDER_u-boot_mx7 = "u-boot-senzacarta"
PREFERRED_PROVIDER_virtual/bootloader_mx7 = "u-boot-senzacarta"
PREFERRED_PROVIDER_virtual/kernel_mx7 = "linux-senzacarta"
PREFERRED_VERSION_linux-senzacarta ?= "4.19"

KERNEL_DEVICETREE = "imx7d-sdb.dtb"

#UBOOT_CONFIG ??= "${@bb.utils.contains('COMBINED_FEATURES', 'optee', 'sd-optee', 'sd', d)}"
UBOOT_CONFIG ??= "sd"
UBOOT_CONFIG[sd] = "mx7dsenzacarta_config,sdcard"
UBOOT_CONFIG[epdc] = "mx7dsenzacarta_config"
UBOOT_CONFIG[mfgtool] = "mx7dsenzacarta_config"
#UBOOT_CONFIG[sd-optee] = "mx7dsabresd_optee_config,sdcard"

OPTEE_BIN_EXT = "7dsdb"

XSERVER += "mesa-driver-swrast"
```
